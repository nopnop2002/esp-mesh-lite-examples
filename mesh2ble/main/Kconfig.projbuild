## mesh2ble/main/Kconfig.projbuild
```kconfig
menu "Example Configuration"

	config MESH_ROOT
		select JOIN_MESH_IGNORE_ROUTER_STATUS
		bool "Root device"
		default n
		help
			Configure the root device type.

	config MESH_CHANNEL
		int "Mesh network channel"
		range 1 14
		default 11
		help
			Mesh network channel.

	choice PRINT_FORMAT
		depends on MESH_ROOT
		prompt "Select JSON print format"
		default PRINT_UNFORMATTED
		help
			Select JSON print format.
		config PRINT_FORMATTED
			bool "FORMATTED"
			help
				Print formatted 
		config PRINT_UNFORMATTED
			bool "UNFORMATTED"
			help
				Print unformatted 
	endchoice

endmenu
```

## mesh2ble/sdkconfig.defaults
```kconfig
# Override some defaults in mesh application project.

#
# Partition Table
#
CONFIG_PARTITION_TABLE_CUSTOM=y
CONFIG_PARTITION_TABLE_CUSTOM_FILENAME="partitions_example.csv"
CONFIG_PARTITION_TABLE_FILENAME="partitions_example.csv"

#
# Bluetooth
#
CONFIG_BT_ENABLED=y
CONFIG_BT_BLUEDROID_ENABLED=n
CONFIG_BT_NIMBLE_ENABLED=y

#
# Controller Options
#
CONFIG_BTDM_CTRL_MODE_BLE_ONLY=y
CONFIG_BTDM_CTRL_MODE_BR_EDR_ONLY=n
CONFIG_BTDM_CTRL_MODE_BTDM=n

#
# FreeRTOS
#
CONFIG_FREERTOS_HZ=1000
CONFIG_FREERTOS_TIMER_TASK_STACK_DEPTH=3072
CONFIG_FREERTOS_USE_TRACE_FACILITY=y
CONFIG_FREERTOS_USE_STATS_FORMATTING_FUNCTIONS=y
CONFIG_FREERTOS_VTASKLIST_INCLUDE_COREID=y
CONFIG_FREERTOS_GENERATE_RUN_TIME_STATS=y

#
# ESP32-specific
#
CONFIG_ESP_TASK_WDT_PANIC=y
CONFIG_ESP_TASK_WDT_TIMEOUT_S=10
CONFIG_ESP_TIMER_TASK_STACK_SIZE=4096

# LWIP
CONFIG_LWIP_IP_FORWARD=y
CONFIG_LWIP_IPV4_NAPT=y

CONFIG_MESH_LITE_ENABLE=y
CONFIG_MESH_LITE_NODE_INFO_REPORT=y

CONFIG_BRIDGE_SOFTAP_SSID_END_WITH_THE_MAC=y
```

## mesh2can/main/Kconfig.projbuild
```kconfig
menu "Example Configuration"

	config GPIO_RANGE_MAX
		int
		default 33 if IDF_TARGET_ESP32
		default 46 if IDF_TARGET_ESP32S2
		default 48 if IDF_TARGET_ESP32S3
		default 18 if IDF_TARGET_ESP32C2
		default 19 if IDF_TARGET_ESP32C3
		default 30 if IDF_TARGET_ESP32C6

	config MESH_ROOT
		select JOIN_MESH_IGNORE_ROUTER_STATUS
		bool "Root device"
		default n
		help
			Configure the root device type.

	config MESH_CHANNEL
		int "Mesh network channel"
		range 1 14
		default 11
		help
			Mesh network channel.

	choice CAN_BITRATE
		depends on MESH_ROOT
		prompt "CAN Bitrate"
		default CAN_BITRATE_500
		help
			Select the CAN bitrate for the example.
		config CAN_BITRATE_25
			bool "BITRATE_25"
			help
				CAN bitrate is 25 Kbit/s.
		config CAN_BITRATE_50
			bool "BITRATE_50"
			help
				CAN bitrate is 50 Kbit/s.
		config CAN_BITRATE_100
			bool "BITRATE_100"
			help
				CAN bitrate is 100 Kbit/s.
		config CAN_BITRATE_125
			bool "BITRATE_125"
			help
				CAN bitrate is 125 Kbit/s.
		config CAN_BITRATE_250
			bool "BITRATE_250"
			help
				CAN bitrate is 250 Kbit/s.
		config CAN_BITRATE_500
			bool "BITRATE_500"
			help
				CAN bitrate is 500 Kbit/s.
		config CAN_BITRATE_800
			bool "BITRATE_800"
			help
				CAN bitrate is 800 Kbit/s.
		config CAN_BITRATE_1000
			bool "BITRATE_1000"
			help
				CAN bitrate is 1 Mbit/s.
	endchoice

	config CTX_GPIO
		depends on MESH_ROOT
		int "CTX GPIO number"
		range 0 GPIO_RANGE_MAX
		default 21 if IDF_TARGET_ESP32
		default 17 if IDF_TARGET_ESP32S2 || IDF_TARGET_ESP32S3
		default  0 # C3 and others
		help
			GPIO number (IOxx) to CTX.
			Some GPIOs are used for other purposes (flash connections, etc.).
			GPIOs 35-39 are input-only so cannot be used as outputs.

	config CRX_GPIO
		depends on MESH_ROOT
		int "CRX GPIO number"
		range 0 GPIO_RANGE_MAX
		default 22 if IDF_TARGET_ESP32
		default 18 if IDF_TARGET_ESP32S2 || IDF_TARGET_ESP32S3
		default  1 # C3 and others
		help
			GPIO number (IOxx) to CRX.
			Some GPIOs are used for other purposes (flash connections, etc.).
			GPIOs 35-39 are input-only so cannot be used as outputs.

	choice CAN_FRAME_TYPE
		depends on !MESH_ROOT
		prompt "Select CAN Frame type to send"
		default CAN_STD_FRAME
		help
			Select CAN Frame type.
		config CAN_STD_FRAME
			bool "Standard frame"
			help
				Standard frame 
		config CAN_EXT_FRAME
			bool "Extended frame"
			help
				Extended frame 
	endchoice

	config CAN_ID
		depends on !MESH_ROOT
		range 0 0x1FF if CAN_STD_FRAME
		range 0 0x1FFFFFFF if CAN_EXT_FRAME
		default 0x1FF if CAN_STD_FRAME
		default 0x1FFFFFFF if CAN_EXT_FRAME
		hex "CAN ID to send"
		help
			CAN ID to send.

endmenu
```

## mesh2uart/main/Kconfig.projbuild
```kconfig
menu "Example Configuration"

	config GPIO_RANGE_MAX
		int
		default 33 if IDF_TARGET_ESP32
		default 46 if IDF_TARGET_ESP32S2
		default 48 if IDF_TARGET_ESP32S3
		default 18 if IDF_TARGET_ESP32C2
		default 19 if IDF_TARGET_ESP32C3
		default 30 if IDF_TARGET_ESP32C6

	config MESH_ROOT
		select JOIN_MESH_IGNORE_ROUTER_STATUS
		bool "Root device"
		default n
		help
			Configure the root device type.

	config MESH_CHANNEL
		int "Mesh network channel"
		range 1 14
		default 11
		help
			Mesh network channel.

	choice INTERFACE
		depends on MESH_ROOT
		prompt "Interface"
		default UART_INTERFACE
		help
			Select Interface.
		config UART_INTERFACE
			bool "UART Interface"
			help
				UART Interface.
		config USB_INTERFACE
			depends on IDF_TARGET_ESP32S2 || IDF_TARGET_ESP32S3
			bool "USB Interface"
			help
				USB Interface.
	endchoice

	config UART_TX_GPIO
		depends on MESH_ROOT
		depends on UART_INTERFACE
		int "UART TX GPIO number"
		range 0 GPIO_RANGE_MAX
		default 17 if IDF_TARGET_ESP32
		default  2 if IDF_TARGET_ESP32S2 || IDF_TARGET_ESP32S3
		default  1 # C3 and others
		help
			GPIO number (IOxx) to UART TX.

	config UART_RX_GPIO
		depends on MESH_ROOT
		depends on UART_INTERFACE
		int "UART RX GPIO number"
		range 0 GPIO_RANGE_MAX
		default 16 if IDF_TARGET_ESP32
		default  1 if IDF_TARGET_ESP32S2 || IDF_TARGET_ESP32S3
		default  0 # C3 and others
		help
			GPIO number (IOxx) to UART RX.

	config UART_BAUD_RATE
		depends on MESH_ROOT
		depends on UART_INTERFACE
		int "UART communication speed"
		range 1200 115200
		default 115200
		help
			UART communication speed.

	choice PRINT_FORMAT
		depends on MESH_ROOT
		prompt "Select JSON print format"
		default PRINT_UNFORMATTED
		help
			Select JSON print format.
		config PRINT_FORMATTED
			bool "FORMATTED"
			help
				Print formatted 
		config PRINT_UNFORMATTED
			bool "UNFORMATTED"
			help
				Print unformatted 
	endchoice

endmenu
```

## mesh_ftp-client/main/Kconfig.projbuild
```kconfig
menu "Example Configuration"

	menu "WiFi Setting"

		config ROUTER_SSID
			string "Router SSID"
				default "myssid"
				help
					SSID (network name) for the example to connect to.

		config ROUTER_PASSWORD
			string "Router password"
				default "mypassword"
				help
					WiFi password (WPA or WPA2) for the example to use.

	endmenu

	menu "FTP Server Setting"

		config FTP_SERVER
			string "FTP Server Host"
			default "ftp.dlptest.com"
			help
				FTP Server host name or ip address to connect.

		config FTP_PORT
			int "FTP Server Port"
			default 21
			help
				FTP Server port number to connect.

		config FTP_USER
			string "FTP User Name"
			default "dlpuser"
			help
				FTP User name to use.

		config FTP_PASSWORD
			string "FTP Password"
			default "rNrKYTX9g7z3RgJRmxWuGHbeu"
			help
				FTP Password to use.

	endmenu

endmenu
```

## mesh_http_client/main/Kconfig.projbuild
```kconfig
menu "Example Configuration"

	config ROUTER_SSID
		string "Router SSID"
			default "myssid"
			help
				SSID (network name) for the example to connect to.

	config ROUTER_PASSWORD
		string "Router password"
			default "mypassword"
			help
				WiFi password (WPA or WPA2) for the example to use.

	config SERVER_IP
		string "HTTP Server IP address"
		default "192.168.0.1"
		help
			Server IP address.

	config SERVER_PORT
		int "HTTP Server port"
		default 8080
		help
			Server port.

endmenu
```

## mesh_remote_logging/main/Kconfig.projbuild
```kconfig
menu "Example Configuration"

config ROUTER_SSID
    string "Router SSID"
        default "ROUTER_SSID"
        help
            Router SSID.

config ROUTER_PASSWORD
    string "Router password"
        default "ROUTER_PASSWORD"
        help
            Router password.

config TCP_SERVER_IP
    string "TCP Server IP address"
        default "192.168.0.1"
        help
            TCP Server IP address.

config TCP_SERVER_PORT
    int "TCP Server port"
        default "8070"
        help
            TCP Server port.

config LOGGING_SERVER_IP
    string "LOGGING Server IP address"
        default "192.168.0.1"
        help
            LOGGING Server IP address.

config LOGGING_SERVER_PORT
    int "LOGGING Server port"
        default "8090"
        help
            LOGGING Server port.

endmenu
```

## mesh_sntp_client/main/Kconfig.projbuild
```kconfig
menu "Example Configuration"

	menu "WiFi Setting"

		config ROUTER_SSID
			string "Router SSID"
				default "myssid"
				help
					SSID (network name) for the example to connect to.

		config ROUTER_PASSWORD
			string "Router password"
				default "mypassword"
				help
					WiFi password (WPA or WPA2) for the example to use.

	endmenu

	menu "NTP Setting"

		config NTP_SERVER
			string "Hostname for NTP Server"
			default "pool.ntp.org"
			help
				Hostname for NTP Server.

		config LOCAL_TIMEZONE
			int "Your local timezone"
			range -23 23
			default 0
			help
				Your local timezone.  When it is 0, Greenwich Mean Time.

	endmenu

endmenu
```

## mesh_websocket_server/main/Kconfig.projbuild
```kconfig
menu "Example Configuration"

	config MESH_ROOT
		select JOIN_MESH_IGNORE_ROUTER_STATUS
		bool "Root device"
		default n
		help
			Configure the root device type.

	config ROUTER_SSID
		string "Router SSID"
			default "myssid"
			help
				SSID (network name) for the example to connect to.

	config ROUTER_PASSWORD
		string "Router password"
			default "mypassword"
			help
				WiFi password (WPA or WPA2) for the example to use.

	config MDNS_HOSTNAME
		depends on MESH_ROOT
		string "mDNS Hostname"
		default "esp32-server"
		help
			The mDNS host name used by the ESP32.

	config NODE_COMMENT
		depends on !MESH_ROOT
		string "Node comment"
			default "Node comment"
			help
				Node comment.

endmenu
```

## router_less_message_exchange/main/Kconfig.projbuild
```kconfig
menu "Example Configuration"

	config MESH_ROOT
		select JOIN_MESH_IGNORE_ROUTER_STATUS
		bool "Root device"
		default n
		help
			Configure the root device type.

	config MESH_CHANNEL
		int "Mesh network channel"
		range 1 14
		default 11
		help
			Mesh network channel.

	choice FORMAT
		prompt "Select message format"
		default JSON_FORMAT
		help
			Select message format.
		config JSON_FORMAT
			bool "JSON Format"
			help
				Use JSON format.
		config RAW_FORMAT
			bool "Plain Text Format"
			help
				Use Plain Text Format.
	endchoice

	config ENCRYPTION
		bool "Enable AES encryption"
		default false
		help
			Enable AES encryption.

endmenu
```
